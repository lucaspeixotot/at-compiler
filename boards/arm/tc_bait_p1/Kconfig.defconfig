## boards/arm/tc_bait_p1/Kconfig.defconfig
```kconfig
# Kconfig - Trucks Control Bait P1 board with STM32F091CC MCU configuration
#
# Copyright (c) 2018 Trucks Control
#
#

if BOARD_TC_BAIT_P1

config BOARD
	default "tc_bait_p1"

config UART_1
	default y

# UART 3 is configured using STM32CUBEMX generated functions

config UART_4
	default y

if UART_CONSOLE

config UART_2
	default y

endif # UART_CONSOLE

if I2C

config I2C_1
	default y

endif # I2C

endif # BOARD_TC_BAIT_P1
```

## boards/arm/tc_bait_p1/tc_bait_p1_defconfig
```kconfig
# Zephyr Kernel Configuration
CONFIG_ARM=y
CONFIG_SOC_SERIES_STM32F0X=y

# Platform Configuration
CONFIG_SOC_STM32F091XC=y
CONFIG_BOARD_TC_BAIT_P1=y

# General Kernel Options
CONFIG_CORTEX_M_SYSTICK=y
CONFIG_SYS_CLOCK_HW_CYCLES_PER_SEC=16000000

CONFIG_SYS_CLOCK_TICKS_PER_SEC=1000

# Serial Drivers
CONFIG_SERIAL=y
CONFIG_UART_INTERRUPT_DRIVEN=y
# enable console
CONFIG_CONSOLE=y
CONFIG_UART_CONSOLE=y

# I2C configuration
CONFIG_I2C=y
CONFIG_I2C_1=y
# Enable LIS3DH sensor Driver (DISABLED FOR NOW)
CONFIG_SENSOR=y
CONFIG_LIS3DH=y
CONFIG_LIS3DH_TRIGGER_OWN_THREAD=y
CONFIG_LIS3DH_THREAD_PRIORITY=2
CONFIG_LIS3DH_THREAD_STACK_SIZE=1024

# Pinmux Driver
CONFIG_PINMUX=y

# GPIO Controller
CONFIG_GPIO=y

# Clock configuration
CONFIG_CLOCK_CONTROL=y
# CONFIG_CLOCK_CONTROL_QUARK_SE is not set
CONFIG_CLOCK_CONTROL_STM32_CUBE=y
CONFIG_CLOCK_CONTROL_STM32_DEVICE_INIT_PRIORITY=1
# CONFIG_CLOCK_STM32_SYSCLK_SRC_HSE is not set
# CONFIG_CLOCK_STM32_SYSCLK_SRC_HSI is not set
CONFIG_CLOCK_STM32_SYSCLK_SRC_PLL=y
CONFIG_CLOCK_STM32_PLL_SRC_HSI=y
# CONFIG_CLOCK_STM32_PLL_SRC_HSE is not set
CONFIG_CLOCK_STM32_PLL_PREDIV=2
CONFIG_CLOCK_STM32_PLL_MULTIPLIER=4
CONFIG_CLOCK_STM32_AHB_PRESCALER=1
CONFIG_CLOCK_STM32_APB1_PRESCALER=1
CONFIG_CLOCK_STM32_MCO1_SRC_NOCLOCK=y
CONFIG_CLOCK_STM32_MCO2_SRC_NOCLOCK=y
```

## boards/arm/tc_bait_p2/Kconfig.board
```kconfig
# Kconfig - Trucks Control Bait P1 board with STM32F091CC MCU configuration
#
# Copyright (c) 2018 Trucks Control
#
#

config BOARD_TC_BAIT_P2
	bool "TRUCKS CONTROL BAIT Prototype 1"
	depends on SOC_STM32F091XC
```

## boards/arm/tc_bait_p2/Kconfig.defconfig
```kconfig
# Kconfig - Trucks Control Bait P1 board with STM32F091CC MCU configuration
#
# Copyright (c) 2018 Trucks Control
#
#

if BOARD_TC_BAIT_P2

config BOARD
	default "tc_bait_p2"

config UART_1
	default y

# UART 3 is configured using STM32CUBEMX generated functions

config UART_4
	default y

config USE_STM32_LL_USART
	default y

config USE_STM32_LL_GPIO
	default y

config USE_STM32_HAL_PWR
	default y

if UART_CONSOLE

config UART_2
	default y

endif # UART_CONSOLE

# RTC configuration

if RTC

config RTC_0
	bool
	default y

endif # RTC

if I2C

config I2C_1
	default y

endif # I2C

endif # BOARD_TC_BAIT_P1
```

## boards/arm/tc_bait_p2/tc_bait_p2_defconfig
```kconfig
# Zephyr Kernel Configuration
CONFIG_ARM=y
CONFIG_SOC_SERIES_STM32F0X=y

# Platform Configuration
CONFIG_SOC_STM32F091XC=y
CONFIG_BOARD_TC_BAIT_P2=y

# General Kernel Options
CONFIG_CORTEX_M_SYSTICK=y
CONFIG_SYS_CLOCK_HW_CYCLES_PER_SEC=8000000

#CONFIG_SYS_CLOCK_TICKS_PER_SEC=1000

# Serial Drivers
CONFIG_SERIAL=y
CONFIG_UART_INTERRUPT_DRIVEN=y
# enable console
CONFIG_CONSOLE=y
#CONFIG_UART_CONSOLE=y

CONFIG_HAS_STM32CUBE=y

# I2C configuration
CONFIG_I2C=y
CONFIG_I2C_1=y
# Enable LIS2DH sensor Driver (DISABLED FOR NOW)
CONFIG_SENSOR=y
#CONFIG_LIS2DH=y
#CONFIG_LIS2DH_TRIGGER_OWN_THREAD=y
#CONFIG_LIS2DH_THREAD_PRIORITY=2
#CONFIG_LIS2DH_THREAD_STACK_SIZE=1024

# RTC configuration
#CONFIG_RTC=y
#CONFIG_RTC_STM32=y
#CONFIG_USE_STM32_LL_RTC=y
#CONFIG_USE_STM32_LL_PWR=y
#CONFIG_USE_STM32_LL_RCC=y
#CONFIG_USE_STM32_LL_EXTI=y
#CONFIG_RTC_STM32_CLOCK_LSI=y

# Pinmux Driver
CONFIG_PINMUX=y

# GPIO Controller
CONFIG_GPIO=y

## Clock configuration
#CONFIG_CLOCK_CONTROL=y
#CONFIG_CLOCK_CONTROL_STM32_CUBE=y
#CONFIG_CLOCK_CONTROL_STM32_DEVICE_INIT_PRIORITY=1
#CONFIG_CLOCK_STM32_SYSCLK_SRC_PLL=y
#CONFIG_CLOCK_STM32_PLL_SRC_HSI=y
#CONFIG_CLOCK_STM32_PLL_PREDIV=2
#CONFIG_CLOCK_STM32_PLL_MULTIPLIER=4
#CONFIG_CLOCK_STM32_AHB_PRESCALER=1
#CONFIG_CLOCK_STM32_APB1_PRESCALER=1
##CONFIG_CLOCK_STM32_MCO1_SRC_NOCLOCK=y
##CONFIG_CLOCK_STM32_MCO2_SRC_NOCLOCK=y


# Clock configuration
CONFIG_CLOCK_CONTROL=y
CONFIG_CLOCK_STM32_SYSCLK_SRC_HSI=y
CONFIG_CLOCK_STM32_AHB_PRESCALER=1
CONFIG_CLOCK_STM32_APB1_PRESCALER=1
```
